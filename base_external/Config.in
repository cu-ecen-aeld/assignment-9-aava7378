## base_external/Config.in
```kconfig
menu "AAVA7378 packages"
	source "$BR2_EXTERNAL_AAVA7378_PATH/package/aesd-char-driver/Config.in"
	source "$BR2_EXTERNAL_AAVA7378_PATH/package/aesd-assignments/Config.in"
endmenu
```

## base_external/package/aesd-char-driver/Config.in
```kconfig
config BR2_PACKAGE_AESD_CHAR_DRIVER
	bool "aesd-char-driver"
	help
	  AESD character driver kernel module
```
